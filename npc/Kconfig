## npc/Kconfig
```kconfig
mainmenu "NEMU Configuration Menu"

choice
  prompt "Base ISA"
  default ISA_riscv
config ISA_mips32
  bool "mips32"
config ISA_riscv
  bool "riscv"
endchoice

config ISA
  string
  default "mips32" if ISA_mips32
  default "riscv32" if ISA_riscv && !RV64
  default "riscv64" if ISA_riscv &&  RV64
  default "none"

config ISA64
  depends on ISA_riscv && RV64
  bool
  default y


if ISA_riscv
source "csrc/isa/riscv32/Kconfig"
endif


choice
  prompt "Optimization Level"
  default CC_O2
config CC_O0
  bool "O0"
config CC_O1
  bool "O1"
config CC_O2
  bool "O2"
config CC_O3
  bool "O3"
endchoice

config CC_OPT
  string
  default "-O0" if CC_O0
  default "-O1" if CC_O1
  default "-O2" if CC_O2
  default "-O3" if CC_O3
  default "none"

menu "Verilator Simulation"
config WAVE_DUMP
	bool "Enable wave dump"
	default y
endmenu

menu "Testing and Debugging"


config TRACE
  bool "Enable tracer"
  default y

config TRACE_START
  depends on TRACE
  int "When tracing is enabled (unit: number of instructions)"
  default 0

config TRACE_END
  depends on TRACE
  int "When tracing is disabled (unit: number of instructions)"
  default 10000

config ITRACE
  depends on TRACE && TARGET_NATIVE_ELF && ENGINE_INTERPRETER
  bool "Enable instruction tracer"
  default y

config ITRACE_COND
  depends on ITRACE
  string "Only trace instructions when the condition is true"
  default "true"

config MTRACE
  depends on TRACE
  bool "Enable memory tracer"
  default y

config MTRACE_RANGE_COND
  depends on MTRACE
  bool "Only track the specified range of memory"
  default y

config MTRACE_RANGE_MIN
  depends on MTRACE_RANGE_COND
  hex "Minimum value of the tracked memory address"
  default "0x80000000"

config MTRACE_RANGE_MAX
  depends on MTRACE_RANGE_COND
  hex "Maximum value of  the tracked memory address"
  default "0x88000000"

config DIFFTEST
  bool "Enable differential testing"
  default n
  help
    Enable differential testing with a reference design.

choice
  prompt "Reference design"
  default DIFFTEST_REF_NEMU if ISA_riscv
  default DIFFTEST_REF_SPIKE 
  default DIFFTEST_REF_QEMU
  depends on DIFFTEST

config DIFFTEST_REF_QEMU
  bool "QEMU, communicate with socket"
if ISA_riscv
config DIFFTEST_REF_SPIKE
  bool "Spike"
endif
endchoice

config DIFFTEST_REF_PATH
  string
  default "tools/qemu-diff" if DIFFTEST_REF_QEMU
  default "tools/spike-diff" if DIFFTEST_REF_SPIKE
  default "none"

config DIFFTEST_REF_NAME
  string
  default "nemu" if DIFFTEST_REF_NEMU
  default "qemu" if DIFFTEST_REF_QEMU
  default "spike" if DIFFTEST_REF_SPIKE
  default "none"
endmenu
```
